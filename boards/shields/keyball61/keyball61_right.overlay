/*
 * Правая половина Keyball61 (с трекболом PMW3360), периферийная часть:
 * подключается к донглу, а не к компьютеру.
 *   NCS  -> Pro Micro D10  (P0.09)
 *   MOSI -> Pro Micro D16  (P0.10)
 *   MISO -> Pro Micro D14  (P1.11)
 *   SCLK -> Pro Micro D15  (P1.13)
 */

#include "keyball61.dtsi"
#include <zephyr/dt-bindings/gpio/nordic-nrf-gpio.h>
#include "keyball61_trackball_split.dtsi"
#include <input/processors.dtsi>
#include <dt-bindings/zmk/input_transform.h>

/* Ключи правой половины идут в карте после ключей левой */
&default_transform {
    col-offset = <9>;
};

&pro_micro_spi {
    status = "okay";
    /* Усиленная мощность вывода NCS: помогает при утечке на линию MOSI */
    cs-gpios = <&pro_micro 10 (GPIO_ACTIVE_LOW | NRF_GPIO_DRIVE_H0H1)>;

    trackball: trackball@0 {
        compatible = "pixart,pmw3360";
        reg = <0>;
        spi-max-frequency = <2000000>;
        cpi = <500>;

    };
};

/* События трекбола передаются донглу. Оси датчика повёрнуты на 90 градусов
 * относительно курсора, поэтому меняем X и Y местами уже здесь. */
&trackball_split {
    device = <&trackball>;
    input-processors = <&zip_xy_transform INPUT_TRANSFORM_XY_SWAP>;
};
